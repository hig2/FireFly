//Модуль опроса термистора

int termoPin = A0;

const unsigned int temperature_table[] {
    63358, 63250, 63137, 63020, 62899, 62772, 62641, 62504,
    62363, 62216, 62064, 61906, 61743, 61574, 61399, 61218,
    61031, 60837, 60637, 60431, 60218, 59997, 59768, 59533,
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    17467, 17124, 16788, 16457, 16132, 15814
};

void readTermoFuel(){
  globalState[1] = getAdcTermo();
}

int getAdcTermo(){
  unsigned int acc = 0;
  for(int i = 0; i < 64; i++){
    acc += analogReadFast(termoPin); // ускоренная версия аналог рида 21мКс вместо 112мКс
  }

  if(acc >= temperature_table[0]){ 
    return 0;
  }else if(acc <= temperature_table[125]){ // при двух преведущих операциях мы сравниваем акк на прямую, а в последущем через выччитание ?
    return 125;
  }else {// в описании к функции abs() предупреждается о некоректной работе функции при внесении в качестве аргумента мат.вычисления (нам нужно математику вынести за abs())
    int result = abs(acc - temperature_table[0]); 
    int item = 0;
    for(int i = 1; i < 125; i++){
      if(abs(acc - temperature_table[i])< result){
        result = abs(acc - temperature_table[i]);
        item = i;
      }
    }
    return item;
  }
}


void termoWatcher(){
  const int gist = 50;
  if(globalState[0] == 1 && (globalState[1] >= globalState[8]) && globalState[7] == 0){ // проверка на удерживаемую температуру
    globalState[0] = 2; // переход в другую фазу
  }
}
